; --------------------------------------------------------------------------------
; @Title: Example script for programming of SPC570S50 (Velvety) internal flash.
;
; @Description:
; Script arguments:
;
;   DO spc570s [PREPAREONLY] [SKIPCONFIG]
;
;     PREPAREONLY only declares flash but does not execute flash programming
;     SKIPCONFIG  skip configuration part to allow script external configuration
;
; Example:
;
;   DO ~~/demo/powerpc/flash/spc570s PREPAREONLY SKIPCONFIG
;
; @Author: rweiss
; @Chip: SPC570S50
; @Copyright: (C) 1989-2014 Lauterbach GmbH, licensed for use with TRACE32(R) only
; --------------------------------------------------------------------------------
; $Rev: 3852 $
; $Id: spc570s.cmm 3852 2016-08-17 07:23:46Z rweiss $

LOCAL &parameters &param_prepareonly &param_skipconfig
ENTRY %LINE &parameters
&param_prepareonly=(STRing.SCAN(STRing.UPpeR("&parameters"),"PREPAREONLY",0)!=-1)
&param_skipconfig=(STRing.SCAN(STRing.UPpeR("&parameters"),"SKIPCONFIG",0)!=-1)

; --------------------------------------------------------------------------------
; CPU setup

IF !&param_skipconfig
(
  SYStem.RESet
  SYStem.BdmClock 2MHz
  SYStem.DETECT CPU
  SYStem.Option.WATCHDOG OFF
  SYStem.Up

  ; Initialize internal SRAM (only partially used)
  Data.Set EA:0x40000000--0x40003FFF %Quad 0
)

; --------------------------------------------------------------------------------
; Flash declaration

FLASH.RESet

; Low address space
FLASH.Create 1. 0x00404000--0x00405FFF NOP    Quad 0x0000 /INFO "BAF (read only)"
FLASH.Create 1. 0x00FC0000--0x00FC3FFF TARGET Quad 0x0001
FLASH.Create 1. 0x00FC4000--0x00FC7FFF TARGET Quad 0x0002
FLASH.Create 1. 0x00FC8000--0x00FCBFFF TARGET Quad 0x0003
FLASH.Create 1. 0x00FCC000--0x00FCFFFF TARGET Quad 0x0004
FLASH.Create 1. 0x00FD0000--0x00FD7FFF TARGET Quad 0x0005
FLASH.Create 1. 0x00FD8000--0x00FDFFFF TARGET Quad 0x0006
FLASH.Create 1. 0x00FE0000--0x00FEFFFF TARGET Quad 0x0007
FLASH.Create 1. 0x00FF0000--0x00FFFFFF TARGET Quad 0x0008
; High address space (Data Flash)
FLASH.Create 3. 0x00800000--0x00801FFF TARGET Quad 0x0200
FLASH.Create 3. 0x00802000--0x00803FFF TARGET Quad 0x0201
FLASH.Create 3. 0x00804000--0x00805FFF TARGET Quad 0x0202
FLASH.Create 3. 0x00806000--0x00807FFF TARGET Quad 0x0203
; 128k address space
IF CPUIS(SPC570S50*)
(
  FLASH.Create 4. 0x01000000--0x0101FFFF TARGET Quad 0x0300
  FLASH.Create 4. 0x01020000--0x0103FFFF TARGET Quad 0x0301
)
; UTEST address space
FLASH.Create 6. 0x00400000--0x00401FFF TARGET Quad 0x0500 /OTP /INFO "UTEST"

; Overlay enabled mapping
FLASH.CreateALIAS 0x08A00000--0x08FFFFFF 0x00A00000   ; Small & medium flash blocks
FLASH.CreateALIAS 0x09000000--0x09FFFFFF 0x01000000   ; Large flash blocks

FLASH.TARGET E:0x40000000 E:0x40002000 0x1000 ~~/demo/powerpc/flash/quad/c55fmspc570s.bin /STACKSIZE 0x0200

;flash script ends here if called with parameter PREPAREONLY
IF &param_prepareonly
  ENDDO

;--------------------------------------------------------------------------------
;Flash programming

DIALOG.YESNO "Flash programming prepared. Program flash memory now?"
LOCAL &progflash
ENTRY &progflash

IF &progflash 
(
  FLASH.ReProgram ALL /Erase
  Data.LOAD.auto C:\Vector\CBD1800772_D00_Mpc57xx\Demo\DemoFbl\Appl\DemoFbl.elf 0xfc0000--0xfc8008
  FLASH.ReProgram.off 
)
ELSE
(
  FLASH.List
)

ENDDO
