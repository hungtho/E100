// T32 Thu Apr  2 10:36:19 2020

B::

TOOLBAR   ON
STATUSBAR ON
FramePOS 3.25 1.8571 105. 60.
WinPAGE.RESet

WinPAGE.Create P000
WinCLEAR

WinPOS 3.75 2.1429 75. 26. 0. 1. W000
WinTABS 26. 26.
sYmbol.Browse.Function
WinPAN 0. 33.

WinPOS 37.5 1.2857 60. 49. 14. 1. W002
WinTABS 10. 10. 25.
List e:ApplFblWriteDataByIdentifier

WinPOS 0.0 47.143 101. 4. 0. 0. W003
Var.Watch

VAR.ADDWATCH WriteDataBuf
VAR.ADDWATCH flashParam

WinPOS 16.875 9.6429 68. 26. 14. 1. W004
Data.dump e:(00800000) /DIALOG

WinPAGE.select P000

ENDDO
