// T32 Tue Apr  7 15:39:03 2020

B::

TOOLBAR   ON
STATUSBAR ON
FramePOS -203.75,15.0,,,Maximized
WinPAGE.RESet

WinPAGE.Create P000
WinCLEAR

WinPOS 0.0 16.214 115. 14. 0. 1. W003
WinTABS 26. 26.
symbol.Browse

WinPOS 0.0 0.0 115. 12. 0. 0. W005
area

WinPOS 14.375 7.6429 68. 39. 14. 1. W002
Data.dump (0x800000) /DIALOG

WinPOS 119.88 0.0 115. 55. 0. 0. W000
Var.Watch

VAR.ADDWATCH present_addr
VAR.ADDWATCH DTC_BUFFER
VAR.ADDWATCH EEPROM_DTC_BUFFER
VAR.ADDWATCH u32g_LDC_ERR_Sts
VAR.ADDWATCH testInCurr
VAR.ADDWATCH testInVolt
VAR.ADDWATCH testOutCurr
VAR.ADDWATCH testOutVolt
VAR.ADDWATCH testTemp
VAR.ADDWATCH testTempSub
VAR.ADDWATCH testKeyIn
VAR.ADDWATCH testBplus
VAR.ADDWATCH rteVcuCmdLdcTargetVolt
VAR.ADDWATCH rteVcuIgn3Sts
VAR.ADDWATCH rteVcuCmdEnLdc
VAR.ADDWATCH rteLdcMode
VAR.ADDWATCH rteLdcRun

WinPAGE.select P000

ENDDO
